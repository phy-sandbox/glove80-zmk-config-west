## config/west.yml
```yaml
manifest:
  remotes:
    - name: phy-sandbox
      url-base: https://github.com/phy-sandbox
  projects:
    - name: zmk
      remote: phy-sandbox
      revision: glove80_dongle
      import: app/west.yml
  self:
    path: config
```
