/ {
    chosen {
        zmk,underglow-indicators = &underglow_indicators;
    };

    underglow_indicators: underglow-indicators {
        compatible  = "zmk,underglow-indicators";
        /* Renamed from bat-lhs to bat-local (semantic change: local device battery, not left-specific) */
        bat-local   = <36 30 24 18 12 7>;
        usb-state = <2>;
    };
};